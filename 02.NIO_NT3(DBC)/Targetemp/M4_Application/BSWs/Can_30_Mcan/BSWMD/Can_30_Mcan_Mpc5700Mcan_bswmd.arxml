AUTOSAR XML (schema 4-0-3)
# COPYRIGHT
# Copyright (c) 2022 by Vector Informatik GmbH. All rights reserved.
# This software is copyright protected and proprietary to Vector Informatik GmbH.
# Vector Informatik GmbH grants to you only those rights as set out in the license conditions.
package /MICROSAR/Can_Mpc5700Mcan
  bsw implementation Can_Impl: programming-language=C, sw-version=5.10.04, used-code-generator=DaVinci Configurator, vendor-id=30, ar-release-version=4.00.03, behavior=Can_Can_Mpc5700McanBehavior, preconfigured-configuration=Can_Pre, recommended-configuration=Can_Rec, vendor-api-infix=Mcan, vendor-specific-module-def=Can
  module definition Can [0..*]: category=VENDOR_SPECIFIC_MODULE_DEFINITION, refined-module-def=Can, variants pre-compile/link-time/post-build-loadable/post-build-selectable  # The CAN Driver (Can) abstracts the hardware related implementation details of specific CAN communication controller. Upper layer is CanIf. #CAN #ISO11898 #Driver #AUTOSAR
    container CanConfigSet  # This is the multiple configuration set container for CAN Driver.
      container CanController [0..*]  # This container contains the configuration parameters of the CAN controller(s).
        enumeration CanBusoffProcessing: {INTERRUPT, POLLING}, set at pre-compile, default-value=INTERRUPT  # Define the context in which the Busoff will be processed. INTERRUPT: Busoff handling is done in interrupt context by Busoff event. POLLING: Busoff is handled in Function Can_MainFunction_BusOff(). This function has to be called cyclic.
        boolean CanControllerActivation: set at link in variant link-time+post-build-loadable / post-build in variant post-build-selectable / pre-compile in variant pre-compile, default-value=true  # Defines if a CAN controller is used in the configuration.
        integer CanControllerBaseAddress: 0..4294967295, set at link in variant link-time+post-build-loadable / post-build in variant post-build-selectable / pre-compile in variant pre-compile, default-value=0  # Specifies the CAN controller base address.
        integer CanControllerId: 0..255, set at pre-compile, symbolic-name-value=true, default-value=0  # This parameter provides the controller ID which is unique in a given CAN Driver. The value for this parameter starts with 0 and continue without any gaps.
        enumeration CanRxProcessing: {INTERRUPT, POLLING}, set at pre-compile, default-value=INTERRUPT  # Define the context in which the PDU reception will be processed. INTERRUPT: Reception handling is done in interrupt context by event. POLLING: Reception is handled in Function Can_MainFunction_Read(). This function has to be called cyclic.
        enumeration CanTxProcessing: {INTERRUPT, POLLING}, set at pre-compile, default-value=INTERRUPT  # Define the context in which the PDU transmission confirmation will be processed. INTERRUPT: Transmission confirmation handling is done in interrupt context by event. POLLING: Transmission confirmation is handled in Function Can_MainFunction_Write(). This function has to be called cyclic.
        enumeration CanWakeupProcessing: {INTERRUPT, POLLING}, set at pre-compile, default-value=INTERRUPT  # Define the context in which the wakeup event will be processed. INTERRUPT: Wakeup handling is done in interrupt context by event. POLLING: Wakeup is handled in Function Can_MainFunction_Wakeup(). This function has to be called cyclic. RESTRICTIONS: 'CanWakeupProcessing' is only available, if hardware supports this by mean wakeup detection by bus event.
        boolean CanWakeupSupport: set at link in variant link-time+post-build-loadable / post-build in variant post-build-selectable / pre-compile in variant pre-compile, default-value=false  # CAN driver supports wakeup over CAN Bus. RESTRICTIONS: 'CanWakeupSupport' is only available when Hardware supports Wakeup over Bus.
        integer CanWakeupSourceId: 0..65535, set at link in variant link-time+post-build-loadable / post-build in variant post-build-selectable / pre-compile in variant pre-compile, origin=Vector Informatik, default-value=0  # Wakeup Source ID given by EcuM RESTRICTIONS: 'CanWakeupSourceId' is only used when no ECU State Manager Reference is available in the ECUC file. Otherwise the value is given by reference to EcuM in CanWakeupSourceRef.
        boolean CanCommonCAN [0..1]: set at pre-compile, origin=Vector Informatik, default-value=false  # Activate this parameter when you like to connect two physical CAN channels to one logical CAN Controller. This allow you to use more FullCAN objects for this Controller. Only Rx FullCAN objects can be configured on second physical channel. RESTRICTIONS: 'CanCommonCAN' is a project specific feature and may is not available/supported for every platform.
        enumeration CanBasisAddressEnum: {M_CAN0, M_CAN1, M_CAN2, M_CAN3, M_CAN4, M_CAN5, M_CAN6, M_CAN7, M_CAN8, M_CAN9, M_CAN10, M_CAN11, M_CAN12, M_CAN13, M_CAN14, M_CAN15, M_CAN16, M_CAN17, M_CAN18, M_CAN19}, set at link in variant link-time / post-build in variant post-build-loadable+post-build-selectable / pre-compile in variant pre-compile, origin=Vector Informatik, default-value=M_CAN1  # Select the name of the controller..
        enumeration CanIOPort [0..1]: {b_000, b_001, b_010, b_011, b_100, b_101, b_110, b_111}, set at link in variant link-time+post-build-loadable / post-build in variant post-build-selectable / pre-compile in variant pre-compile, origin=Vector Informatik, default-value=b_000  # Receive Input Selection | Only relevant for affected platforms (e.g. Tricore). This is the value for NPCR.RXSEL which selects one out of 8 possible receive inputs. The CAN receive signal is performed only through the selected input.
        enumeration CanTxBufferElementSize: set at link in variant link-time / post-build in variant post-build-loadable+post-build-selectable / pre-compile in variant pre-compile, origin=Vector Informatik, default-value=ES_8  # Configures the number of data bytes belonging to a Tx Buffer (Tx FullCAN and Tx BasicCAN).
          ES_8  # 8 bytes
          ES_12  # 12 bytes
          ES_16  # 16 bytes
          ES_20  # 20 bytes
          ES_24  # 24 bytes
          ES_32  # 32 bytes
          ES_48  # 48 bytes
          ES_64  # 64 bytes
        enumeration CanTxEfBufferElementSize [0..1]: set at link in variant link-time / post-build in variant post-build-loadable+post-build-selectable / pre-compile in variant pre-compile, origin=Vector Informatik, default-value=ES_8  # Configures the number of data bytes belonging to a Tx Event Fifo Buffer.
          ES_8  # 8 bytes
        enumeration CanRxBufferElementSize: set at link in variant link-time / post-build in variant post-build-loadable+post-build-selectable / pre-compile in variant pre-compile, origin=Vector Informatik, default-value=ES_8  # Configures the number of data bytes belonging to a Rx Buffer (Rx FullCAN).
          ES_8  # 8 bytes
          ES_12  # 12 bytes
          ES_16  # 16 bytes
          ES_20  # 20 bytes
          ES_24  # 24 bytes
          ES_32  # 32 bytes
          ES_48  # 48 bytes
          ES_64  # 64 bytes
        enumeration CanRxFifo0ElementSize: set at link in variant link-time / post-build in variant post-build-loadable+post-build-selectable / pre-compile in variant pre-compile, origin=Vector Informatik, default-value=ES_8  # Configures the number of data bytes belonging to an entry of FIFO0.
          ES_8  # 8 bytes
          ES_12  # 12 bytes
          ES_16  # 16 bytes
          ES_20  # 20 bytes
          ES_24  # 24 bytes
          ES_32  # 32 bytes
          ES_48  # 48 bytes
          ES_64  # 64 bytes
        enumeration CanRxFifo1ElementSize: set at pre-compile in variant link-time+pre-compile / post-build in variant post-build-loadable+post-build-selectable, origin=Vector Informatik, default-value=ES_8  # Configures the number of data bytes belonging to an entry of FIFO1.
          ES_8  # 8 bytes
          ES_12  # 12 bytes
          ES_16  # 16 bytes
          ES_20  # 20 bytes
          ES_24  # 24 bytes
          ES_32  # 32 bytes
          ES_48  # 48 bytes
          ES_64  # 64 bytes
        integer CanMaxNrOfRxFifo0Elements: 0..64, set at pre-compile in variant link-time+post-build-loadable+pre-compile / post-build in variant post-build-selectable, origin=Vector Informatik, default-value=64  # Displays the maximum configurable depth for RxFifo0.
        integer CanMaxNrOfRxFifo1Elements: 0..64, set at pre-compile in variant link-time+post-build-loadable+pre-compile / post-build in variant post-build-selectable, origin=Vector Informatik, default-value=64  # Displays the maximum configurable depth for RxFifo1.
        integer CanMaxNrOfRxBuffers: 0..64, set at pre-compile in variant link-time+post-build-loadable+pre-compile / post-build in variant post-build-selectable, origin=Vector Informatik, default-value=64  # Displays the maximum number of configurable Rx FullCAN objects.
        integer CanMaxNrOfTxBuffers: 0..32, set at pre-compile in variant link-time+post-build-loadable+pre-compile / post-build in variant post-build-selectable, origin=Vector Informatik, default-value=32  # Displays the maximum number of configurable tx fullcan objects.
        integer CanMaxNrOfTxEventFifoBuffers [0..1]: 0..32, set at pre-compile in variant link-time+post-build-loadable+pre-compile / post-build in variant post-build-selectable, origin=Vector Informatik, default-value=32  # Displays the maximum number of configurable tx event fifo elements.
        boolean CanIsTTCAN: set at link in variant link-time / post-build in variant post-build-loadable+post-build-selectable / pre-compile in variant pre-compile, origin=Vector Informatik, default-value=false  # Specifies if there is a TT_CAN controller on this channel.
        integer CanInterruptPriority [0..1]: 0..255, set at link in variant link-time+post-build-loadable / post-build in variant post-build-selectable / pre-compile in variant pre-compile, origin=Vector Informatik, default-value=48  # Interrupt Priority | Here you can set the CAN interrupt priority. This setting is irrelevant while using OSEK OS category 2 interrupts.
        reference CanControllerDefaultBaudrate: set at link in variant link-time / post-build in variant post-build-loadable+post-build-selectable / pre-compile in variant pre-compile, destination=CanControllerBaudrateConfig  # Reference to baudrate configuration container configured for the Can Controller as default.
        reference CanCpuClockRef: set at link in variant link-time+post-build-loadable / post-build in variant post-build-selectable / pre-compile in variant pre-compile, destination=McuClockReferencePoint  # Reference to the CPU clock configuration, which is set in the MCU driver configuration
        symbolic name reference CanWakeupSourceRef [0..1]: set at link in variant link-time+post-build-loadable / post-build in variant post-build-selectable / pre-compile in variant pre-compile, destination=EcuMWakeupSource  # Reference to the Wakeup Source for this controller as defined in the ECU State Manager. Implementation Type: reference to EcuM_WakeupSourceType RESTRICTIONS: 'CanWakeupSourceRef' is only used when an ECU State Manager Reference is available in the ECUC. Else use the parameter CanWakeupSourceId. | Implementation Type: reference to EcuM_WakeupSourceType
        foreign reference CanControllerSystemRef [0..1]: set at link in variant link-time+post-build-loadable / post-build in variant post-build-selectable / pre-compile in variant pre-compile, origin=Vector Informatik, destination-type=CAN-COMMUNICATION-CONTROLLER  # Reference to the CAN communication controller in the system extract. Used to get recommended baudrate settings.
        container CanControllerBaudrateConfig [0..255]: post-build-changeable=true  # This container contains bit timing related configuration parameters of the CAN controller(s). When connecting CANoe to your hardware, you have to use the same settings (CanControllerBaudRate, CanControllerSyncJumpWidth and the Sample point) in your hardware and CANoe.
          float CanControllerBaudRate: 0..2000, set at link in variant link-time / post-build in variant post-build-loadable+post-build-selectable / pre-compile in variant pre-compile, default-value=500  # Specifies the baudrate of the controller in kbps.
          integer CanControllerBaudRateConfigID: 0..65535, set at link in variant link-time / post-build in variant post-build-loadable+post-build-selectable / pre-compile in variant pre-compile, origin=Vector Informatik, default-value=0  # Uniquely identifies a specific baud rate configuration. This ID is used by SetBaudrate API.
          integer CanControllerPropSeg: 0..256, set at link in variant link-time / post-build in variant post-build-loadable+post-build-selectable / pre-compile in variant pre-compile, default-value=20  # Specifies propagation delay in time quantas. TSeg1=Seg1+PropSeg
          integer CanControllerSeg1: 2..256, set at link in variant link-time / post-build in variant post-build-loadable+post-build-selectable / pre-compile in variant pre-compile, default-value=30  # Specifies phase segment 1 in time quantas. TSeg1=Seg1+PropSeg
          integer CanControllerSeg2: 2..128, set at link in variant link-time / post-build in variant post-build-loadable+post-build-selectable / pre-compile in variant pre-compile, default-value=5  # Specifies phase segment 2 in time quantas. TSeg2=Seg2
          integer CanControllerSyncJumpWidth: 1..128, set at link in variant link-time / post-build in variant post-build-loadable+post-build-selectable / pre-compile in variant pre-compile, default-value=1  # Specifies the synchronization jump width for the controller in time quantas.
          integer CanBaudrateClock: 1..1000000, set at link in variant link-time / post-build in variant post-build-loadable+post-build-selectable / pre-compile in variant pre-compile, origin=Vector Informatik, default-value=16000  # Quartz frequency in kHertz used for baudrate calculation RESTRICTIONS: The value is derived from CanCpuClockRef and may be modified by CAN cell prescalers.
          integer CanBaudratePrescaler: 1..512, set at link in variant link-time / post-build in variant post-build-loadable+post-build-selectable / pre-compile in variant pre-compile, origin=Vector Informatik, default-value=2  # baud rate prescaler to calculate time quantum out of CanBaudrateClock
          container CanControllerFdBaudrateConfig [0..1]: post-build-changeable=true  # This optional container contains bit timing related configuration parameters of the CAN controller(s) for payload and CRC of a CAN FD frame. If this container exists the controller supports CAN FD frames.
            float CanControllerFdBaudRate: 1..16000, set at link in variant link-time / post-build in variant post-build-loadable+post-build-selectable / pre-compile in variant pre-compile, origin=Vector Informatik, default-value=500  # Specifies the data segment baud rate of the controller in kbps.
            integer CanControllerPropSeg: 0..32, set at link in variant link-time / post-build in variant post-build-loadable+post-build-selectable / pre-compile in variant pre-compile, origin=Vector Informatik, default-value=3  # Specifies propagation delay in time quantas.
            integer CanControllerSeg1: 1..32, set at link in variant link-time / post-build in variant post-build-loadable+post-build-selectable / pre-compile in variant pre-compile, origin=Vector Informatik, default-value=5  # Specifies phase segment 1 in time quantas.
            integer CanControllerSeg2: 1..16, set at link in variant link-time / post-build in variant post-build-loadable+post-build-selectable / pre-compile in variant pre-compile, origin=Vector Informatik, default-value=1  # Specifies phase segment 2 in time quantas.
            integer CanControllerSyncJumpWidth: 1..16, set at link in variant link-time / post-build in variant post-build-loadable+post-build-selectable / pre-compile in variant pre-compile, origin=Vector Informatik, default-value=2  # Specifies the synchronization jump width for the controller in time quantas. (see also ISO/DIS 11898-1:2015(E))
            integer CanControllerTrcvDelayCompensationFilter [0..1]: 0..127, set at link in variant link-time / post-build in variant post-build-loadable+post-build-selectable / pre-compile in variant pre-compile, origin=Vector Informatik  # Specifies the Transceiver Delay Compensation Filter Window length in minimum time quanta [mtq]
            boolean CanControllerTxBitRateSwitch: set at link in variant link-time / post-build in variant post-build-loadable+post-build-selectable / pre-compile in variant pre-compile, origin=Vector Informatik, default-value=true  # Specifies if the bit rate switching shall be used for transmissions. | If FALSE: CAN FD frames shall be sent without bit rate switching.
            integer CanBaudratePrescaler: 1..32, set at link in variant link-time / post-build in variant post-build-loadable+post-build-selectable / pre-compile in variant pre-compile, origin=Vector Informatik, default-value=1  # baud rate prescaler to calculate time quantum out of CanBaudrateClock
            integer CanControllerSspOffset [0..1]: 0..127, set at link in variant link-time / post-build in variant post-build-loadable+post-build-selectable / pre-compile in variant pre-compile, origin=Vector Informatik  # Controller Secondary Sample Point | Specifies the Transmitter Delay Compensation Offset in minimum time quanta. Transmitter Delay Compensation Offset is used to adjust the position of the Secondary Sample Point (SSP), relative to the beginning of the received bit. If this parameter is configured, the Transmitter Delay Compensation is done by measurement of the CAN controller. If not specified, Transmitter Delay Compensation is disabled.
        container CanFilterMask [0..*]: post-build-changeable=true  # This container contains the configuration (parameters) of the CAN Filter Mask(s).
          integer CanFilterMaskValue: 0..4294967295, set at link in variant link-time / post-build in variant post-build-loadable+post-build-selectable / pre-compile in variant pre-compile, default-value=0  # Describes a mask for hardware-based filtering of CAN identifiers. The CAN identifiers of incoming messages are masked with the appropriate CanFilterMaskValue. Bits holding a 0 mean don't care, i.e. do not compare the message's identifier in the respective bit position. The Filter is defined by Code and Mask part: pass Filter when: receiveID & Mask == Code & Mask Mask Bit 31 used to mask Extended and Mixed ID | The mask shall be build by filling with leading 0. In case of CanIdType EXTENDED or MIXED a 29 bit mask shall be build. In case of CanIdType STANDARD a 11 bit mask shall be build
          integer CanFilterCodeValue: 0..4294967295, set at link in variant link-time / post-build in variant post-build-loadable+post-build-selectable / pre-compile in variant pre-compile, origin=Vector Informatik, default-value=0  # The Filter is defined by Code and Mask part: pass Filter when: received ID & Mask == Code & Mask Code Bit 31 used to mask Mixed ID This value is equal to CanHardwareObject/CanIdValue if there is only one Filter for the Basic CAN Rx HardwareObject used. But for multiple Filters more than one Id Value is needed.
          boolean IsLocked: set at link in variant link-time / post-build in variant post-build-loadable+post-build-selectable / pre-compile in variant pre-compile, origin=Vector Informatik, default-value=false  # This parameter defines whether the settings in this container CanFilterMask shall stay unchanged during GenTool optimization.
        container CanTTController [0..0]  # Not Used. Not Supported. This container is only included and valid if TTCAN SWS is used and TTCAN is enabled. | This container contains the configuration parameters of the TTCAN controller(s) (which are needed in addition to the configuration parameters of the CAN controller(s)). CanTTController is only included, if the controller supports TTCAN.
          integer CanTTControllerApplWatchdogLimit: 0..255, set at pre-compile in variant link-time+pre-compile / post-build in variant post-build-loadable+post-build-selectable, default-value=0  # Defines the maximum time period (unit is 256 times NTU) after which the application has to serve the watchdog.
          integer CanTTControllerCycleCountMax: 0..63, set at pre-compile in variant link-time+pre-compile / post-build in variant post-build-loadable+post-build-selectable, default-value=0  # Defines the value for cycle_count_max. | Allowed values: 0x00: 1 basic cycle 0x01: 2 basic cycles 0x03: 4 basic cycles 0x07: 8 basic cycles 0x0F: 16 basic cycles 0x1F: 32 basic cycles 0x3F: 64 basic cycles
          integer CanTTControllerExpectedTxTrigger: 0..255, set at pre-compile in variant link-time+pre-compile / post-build in variant post-build-loadable+post-build-selectable, default-value=0  # Number of expected_tx_trigger.
          boolean CanTTControllerExternalClockSynchronisation: set at pre-compile in variant link-time+pre-compile / post-build in variant post-build-loadable+post-build-selectable, default-value=false  # Enables/disables the external clock synchronization. | TRUE: External clock synchronization enabled. FALSE: External clock synchronization disabled. This parameter shall only be configurable if parameter CanTTControllerLevel2 equals TRUE.
          boolean CanTTControllerGlobalTimeFiltering: set at pre-compile in variant link-time+pre-compile / post-build in variant post-build-loadable+post-build-selectable, default-value=false  # Enables/disables the global time filtering. | TRUE: Global time filtering enabled. FALSE: Global time filtering disabled. This parameter shall only be configurable if parameter CanTTControllerLevel2 equals TRUE.
          integer CanTTControllerInitialRefOffset: 0..127, set at pre-compile in variant link-time+pre-compile / post-build in variant post-build-loadable+post-build-selectable, default-value=0  # Defines the initial value for ref trigger offset.
          integer CanTTControllerInterruptEnable: 0..1023, set at pre-compile in variant link-time+pre-compile / post-build in variant post-build-loadable+post-build-selectable, default-value=0  # Enables/disables the respective interrupts. | Bit Position set to 1: Enable respective interrupt. Bit Position set to 0: Disable respective interrupt. Bit Position / Interrupt Source: 10: Application Watchdog. 9: Watch Trigger reached. 8: Initialization Watch Trigger reached. 7: Change of Error Level. 6: Tx Overflow. 5: Tx Underflow. 4: Global Time Error. 3: Gap. 2: Start of Cycle. 1: Time Discontinuity. 0: Master State Change. Bit position "1: Time Discontinuity" and "4: Global Time Error" shall only be configurable if parameter CanTTControllerLevel2 equals TRUE.
          boolean CanTTControllerLevel2: set at pre-compile in variant link-time+pre-compile / post-build in variant post-build-loadable+post-build-selectable, default-value=false  # Defines whether Level 2 or Level 1 is used. | TRUE: Level 2. FALSE: Level 1. If this parameter is set to FALSE then all parameters with dependency to CanTTControllerLevel2 need not be configured.
          float CanTTControllerNTUConfig: 0..100, set at pre-compile in variant link-time+pre-compile / post-build in variant post-build-loadable+post-build-selectable, default-value=0  # Defines the config value for NTU (network time unit). | Value given in microseconds. The value configured shall be greater than 0. Together with the local oscillator period, the TUR (time unit ratio) can be derived from the NTU. This parameter shall only be configurable if parameter CanTTControllerLevel2 equals TRUE.
          enumeration CanTTControllerOperationMode: {CAN_TT_EVENT_SYNC_TIME_TRIGGERED, CAN_TT_EVENT_TRIGGERED, CAN_TT_TIME_TRIGGERED}, set at pre-compile in variant link-time+pre-compile / post-build in variant post-build-loadable+post-build-selectable, default-value=CAN_TT_EVENT_TRIGGERED  # Defines the operation mode.
          float CanTTControllerSyncDeviation: 0..100, set at pre-compile in variant link-time+pre-compile / post-build in variant post-build-loadable+post-build-selectable, default-value=0  # Defines the maximum synchronization deviation: | Given as a percentage value of the NTU (network time unit). The value configured shall be greater than 0. This parameter shall only be configurable if parameter CanTTControllerLevel2 equals TRUE.
          boolean CanTTControllerTURRestore: set at pre-compile in variant link-time+pre-compile / post-build in variant post-build-loadable+post-build-selectable, default-value=false  # Enables/disables the TUR restore. | Note that the value configured for TUR can be derived from the value configured for NTU and the local oscillator preriod. TRUE: TUR restore enabled. FALSE: TUR restore disabled. This parameter shall only be configurable if parameter CanTTControllerLevel2 equals TRUE.
          boolean CanTTControllerTimeMaster: set at pre-compile in variant link-time+pre-compile / post-build in variant post-build-loadable+post-build-selectable, default-value=false  # Defines whether the controller acts as a potential time master. | TRUE: Potential time master. FALSE: Time slave.
          integer CanTTControllerTimeMasterPriority: 0..7, set at pre-compile in variant link-time+pre-compile / post-build in variant post-build-loadable+post-build-selectable, default-value=0  # Defines the time master priority.
          integer CanTTControllerTxEnableWindowLength: 1..16, set at pre-compile in variant link-time+pre-compile / post-build in variant post-build-loadable+post-build-selectable, default-value=1  # Length of the tx enable window given in CAN bit times. | Definition parameter "CanTTControllerTxEnableWindowlength" is used such that: Length of enable window = CanTTControllerTxEnableWindowLength + 1
          integer CanTTControllerWatchTriggerGapTimeMark: 0..65535, set at pre-compile in variant link-time+pre-compile / post-build in variant post-build-loadable+post-build-selectable, default-value=0  # watch trigger time mark after a gap
          integer CanTTControllerWatchTriggerTimeMark: 0..65535, set at pre-compile in variant link-time+pre-compile / post-build in variant post-build-loadable+post-build-selectable, default-value=0  # watch trigger time mark
          enumeration CanTTIRQProcessing: {INTERRUPT, POLLING}, set at pre-compile in variant link-time+pre-compile / post-build in variant post-build-loadable+post-build-selectable, default-value=INTERRUPT  # Enables / disables API Can_MainFunction_BusOff() for handling busoff events in polling mode.
      container CanHardwareObject [0..*]: post-build-changeable=true  # This container contains the configuration (parameters) of CAN Hardware Objects.
        enumeration CanHandleType: {BASIC, FULL}, set at link in variant link-time / post-build in variant post-build-loadable+post-build-selectable / pre-compile in variant pre-compile, default-value=BASIC  # Specifies the type (Full-CAN or Basic-CAN) of a hardware object.
        enumeration CanIdType: {EXTENDED, MIXED, STANDARD}, set at link in variant link-time / post-build in variant post-build-loadable+post-build-selectable / pre-compile in variant pre-compile, default-value=STANDARD  # This parameter defines whether the IdValue is of type EXTENDED: All the CANIDs are of type extended only (29 bit). MIXED: The type of CANIDs can be both Standard or Extended. STANDARD: All the CANIDs are of type standard only (11bit). ImplementationType: Can_IdType | - standard identifier - extended identifier - mixed mode ImplementationType: Can_IdType
        integer CanIdValue: 0..4294967295, set at link in variant link-time / post-build in variant post-build-loadable+post-build-selectable / pre-compile in variant pre-compile, default-value=0  # This value specifies the CAN identifier of the CAN message. Rx FullCAN messages: Contain the ID value of the message. Rx BasicCAN message: Specifies (together with the filter mask) the identifiers range that passes the hardware filter.
        integer CanObjectId: 0..65535, set at link in variant link-time / post-build in variant post-build-loadable+post-build-selectable / pre-compile in variant pre-compile, default-value=0  # Holds the handle ID of HRH or HTH. The value of this parameter is unique in a given CAN Driver, and it should start with 0 and continue without any gaps. Hint: this value is auto-calculated by the generator. Restriction: Tx, RxBasicCAN and RxFullCAN for the same controller has to be grouped without gaps. | The HRH and HTH Ids are defined under two different name-spaces. Example: HRH0-0, HRH1-1, HTH0-2, HTH1-3
        enumeration CanObjectType: {RECEIVE, TRANSMIT}, set at link in variant link-time / post-build in variant post-build-loadable+post-build-selectable / pre-compile in variant pre-compile, default-value=RECEIVE  # Specifies if the HardwareObject is used as Transmit or as Receive object.
        boolean CanHwProcessing: set at link in variant link-time / post-build in variant post-build-loadable+post-build-selectable / pre-compile in variant pre-compile, origin=Vector Informatik, default-value=false  # Enable Polling Processing | Define if this hardware object is polled or not. The usage depends on CanIndividualProcessing switch which has to be enabled.
        enumeration CanCommonCANNode [0..1]: {A, B}, set at link in variant link-time / post-build in variant post-build-loadable+post-build-selectable / pre-compile in variant pre-compile, origin=Vector Informatik, default-value=A  # Use this when Feature 'CanCommonCAN' is activated to select the physical channel for this hardware object. RESTRICTIONS: Feature 'CanCommonCAN' has to be enabled. Only selectable for Rx Full CAN hardware objects (all other will be used on channel 'A')
        integer CanObjectHwSize: 1..65535, set at link in variant link-time / post-build in variant post-build-loadable+post-build-selectable / pre-compile in variant pre-compile, origin=Vector Informatik, default-value=6  # This value specifies the numbers of used hardware buffers for this HardwareObject. For BasicCAN Rx mailboxes with configurable size the user can adapt this. Otherwise it will be filled and used by generator only.
        integer CanObjectHwHandle: 0..65535, set at link in variant link-time / post-build in variant post-build-loadable+post-build-selectable / pre-compile in variant pre-compile, origin=Vector Informatik, default-value=0  # Index for first hardware buffer used by this Hardware Object. Hint: Will be filled and used by generator only.
        integer CanMaxDataLen: 0..64, set at link in variant link-time / post-build in variant post-build-loadable+post-build-selectable / pre-compile in variant pre-compile, origin=Vector Informatik, default-value=8  # specifies the maximum amount of used bytes in case of CAN FD is activated.
        integer CanFdPaddingValue: 0..255, set at link in variant link-time / post-build in variant post-build-loadable+post-build-selectable / pre-compile in variant pre-compile, origin=Vector Informatik, default-value=0  # Specifies the value which is used to pad unspecified data in CAN FD frames > 8 bytes for transmission. This is necessary due to the discrete possible values of the DLC if > 8 bytes. If the length of a PDU which was requested to be sent does not match the allowed DLC values, the remaining bytes up to the next possible value shall be padded with this value.
        boolean CanObjectMultiplexedTransmission: set at link in variant link-time / post-build in variant post-build-loadable+post-build-selectable / pre-compile in variant pre-compile, origin=Vector Informatik, default-value=false  # Multiplexed Transmission | Define if this hardware object use Multiplexed Transmission. RESTRICTIONS: 'CanObjectMultiplexedTransmission' is only used if hardware supports this and 'CanObjectType' is of type 'TRANSMIT' and 'CanHandleType' is of type 'BASIC'. This feature cannot be combined with "CanObjectHwFifo".
        boolean CanObjectHwFifo: set at link in variant link-time / post-build in variant post-build-loadable+post-build-selectable / pre-compile in variant pre-compile, origin=Vector Informatik, default-value=false  # Hardware FIFO | Define if this hardware object uses a FIFO. RESTRICTIONS: 'CanObjectHwFifo' is only used if it is supported by the underlying hardware and 'CanObjectType' is of type 'TRANSMIT' and 'CanHandleType' is of type 'BASIC'. This feature cannot be combined with "CanObjectMultiplexedTransmission".
        reference CanControllerRef: set at link in variant link-time / post-build in variant post-build-loadable+post-build-selectable / pre-compile in variant pre-compile, destination=CanController  # Reference to CAN Controller to which the HOH is associated to.
        reference CanFilterMaskRef [0..*]: set at link in variant link-time / post-build in variant post-build-loadable+post-build-selectable / pre-compile in variant pre-compile, destination=CanFilterMask  # Reference to the filter mask that is used for hardware filtering together with the CanIdValue Multiple References for more than one basic can Filter. This is only available for some hardware platforms. | The CanFilterMaskRef is omitted for 1) CanHardwareObjects with CanObjectType set to TRANSMIT 2) CanHardwareObjects with CanObjectType set to RECEIVE if only a single Can ID shall be received via this CanHardwareObjects (i.e., exact match with CanIdValue)
        reference CanMainFunctionRWPeriodRef [0..1]: set at link in variant link-time / post-build in variant post-build-loadable+post-build-selectable / pre-compile in variant pre-compile, destination=CanMainFunctionRWPeriods  # Reference to CanMainFunctionRWPeriod to which the HOH is associated to.
        container CanTTHardwareObjectTrigger [0..0]  # Not Used. Not Supported. This container is only included and valid if TTCAN SWS is used and TTCAN is enabled. | This container contains the configuration (parameters) of TTCAN triggers for Hardware Objects, which are additional to the configuration (parameters) of CAN Hardware Objects. CanTTHardwareObjectTrigger is only included, if the controller supports TTCAN.
          integer CanTTHardwareObjectBaseCycle: 0..63, set at pre-compile in variant link-time+pre-compile / post-build in variant post-build-loadable+post-build-selectable, default-value=0  # Defines the cycle_offset. | CanTTHardwareObjectBaseCycle must be not greater than cycle_count_max.
          integer CanTTHardwareObjectCycleRepetition: 1..64, set at pre-compile in variant link-time+pre-compile / post-build in variant post-build-loadable+post-build-selectable, default-value=1  # Defines the repeat_factor. | CanTTHardwareObjectCycleRepetition shall be a power of two (2), greater than cycle_offset but not greater than cycle_count_max + 1.
          integer CanTTHardwareObjectTimeMark: 0..65535, set at pre-compile in variant link-time+pre-compile / post-build in variant post-build-loadable+post-build-selectable, default-value=0  # Defines the point in time, when the trigger will be activated. | Value is given in cycle time.
          integer CanTTHardwareObjectTriggerId: 0..63, set at pre-compile in variant link-time+pre-compile / post-build in variant post-build-loadable+post-build-selectable, symbolic-name-value=true, default-value=0  # Sequential number which allows separation of different TTCAN triggers configured for one and the same hardware object.
          enumeration CanTTHardwareObjectTriggerType: {CAN_TT_RX_TRIGGER, CAN_TT_TX_REF_TRIGGER, CAN_TT_TX_REF_TRIGGER_GAP, CAN_TT_TX_TRIGGER_EXCLUSIVE, CAN_TT_TX_TRIGGER_MERGED, CAN_TT_TX_TRIGGER_SINGLE}, set at pre-compile in variant link-time+pre-compile / post-build in variant post-build-loadable+post-build-selectable, default-value=CAN_TT_RX_TRIGGER  # Defines the type of the trigger associated with the hardware object. This parameter depends on plain CAN parameter CAN_OBJECT_TYPE. | If CAN_OBJECT_TYPE equals RECEIVE than this parameter is fixed to CAN_TT_RX_TRIGGER. If CAN_OBJECT_TYPE equals TRANSMIT than one of the following literals is configurable: CAN_TT_TX_REF_TRIGGER, CAN_TT_TX_REF_TRIGGER_GAP, CAN_TT_TX_TRIGGER_MERGED, CAN_TT_TX_TRIGGER_SINGLE, CAN_TT_TX_TRIGGER_EXCLUSIVE.
    container CanGeneral  # General configuration parameters of the CAN Driver.
      boolean CanChangeBaudrateApi: set at pre-compile, default-value=false  # This parameter defines whether the Can_ChangeBaudrate API is available or not. | If this parameter is set to true the Can_ChangeBaudrate API shall be supported. Otherwise the API is not supported.
      boolean CanDevErrorDetection: set at pre-compile, default-value=true  # This parameter switches the Development Error Detection and Notification ON or OFF. true: Development error detection is enabled. false: Development error detection is disabled. Note: In general, the development error detection is recommended during pre-test phase. It is not recommended to enable the development error detection in production code due to increased runtime and ROM needs.
      boolean CanHardwareCancellation: set at pre-compile, default-value=false  # Transmit Cancellation | This parameter defines if hardware cancellation shall be supported. Support Hardware Transmit Cancelation. Enable/disable the usage of transmit cancelation out of hardware mailboxes, so that the canceled message will not be send. (this avoids internal priority inversion) RESTRICTIONS: 'CanHardwareCancellation' is only available, if hardware supports this by mean of cancel mailboxes and CanIf-Tx-buffer activated.
      boolean CanIdenticalIdCancellation: set at pre-compile, default-value=false  # Enables/disables cancellation of pending PDUs with identical ID. 'Hardware Transmit Cancelation' also cancels messages with same identifier (newer data will be send) out of hardware mailboxes. otherwise only lower prior identifiers will be cancelled. (older data will be send) RESTRICTIONS: 'CanIdenticalIdCancellation' is only used when CAN Interface parameter 'CanIfTransmitCancellation' is set.
      integer CanIndex: 0..255, set at pre-compile, default-value=0  # Specifies the InstanceId of this module instance. If only one instance is present it shall have the Id 0.
      function name CanLPduReceiveCalloutFunction [0..1]: set at pre-compile, default-value=Appl_GenericPrecopy  # Not Used. (Use instead 'CanGenericPrecopy') This parameter defines the existence and the name of a callout function that is called after a successful | reception of a received CAN Rx L-PDU. If this parameter is omitted no callout shall take place.
      float CanMainFunctionBusoffPeriod: 0.001..65.535, set at pre-compile, default-value=0.01  # This value specifies the period for cyclic call to Can_MainFunction_Busoff. EcuC unit is seconds.
      float CanMainFunctionModePeriod: 0.001..65.535, set at pre-compile, default-value=0.01  # This value specifies the period for cyclic call to Can_MainFunction_Mode. EcuC unit is seconds.
      float CanMainFunctionWakeupPeriod: 0.001..65.535, set at pre-compile, default-value=0.01  # This value specifies describes the period for cyclic call to Can_MainFunction_Wakeup. EcuC unit is seconds.
      boolean CanMultiplexedTransmission: set at pre-compile, default-value=false  # Specifies if multiplexed transmission shall be supported.(ON, OFF). This switch will be set automatically for precompile configurations depending on the 'CanObjectMultiplexedTransmission' settings of the 'CanHardwareObject'. RESTRICTIONS: 'CanMultiplexedTransmission' is only available, if hardware supports this by mean of multiple priorized mailboxes.
      boolean CanSetBaudrateApi: set at pre-compile, origin=Vector Informatik, default-value=false  # The support of the Can_SetBaudrate API is optional. | If this parameter is set to true the Can_SetBaudrate API shall be supported. Otherwise the API is not supported.
      float CanTimeoutDuration: 1E-06..65.535, set at pre-compile, default-value=0.01  # Specifies the maximum time for blocking function until a timeout is detected. EcuC unit is seconds.
      boolean CanVersionInfoApi: set at pre-compile, default-value=false  # This parameter enables/disables the function Can_GetVersionInfo() to get major, minor and patch version information.
      boolean CanGenericPrecopy: set at pre-compile, origin=Vector Informatik, default-value=false  # This parameter defines whether the Generic Precopy function is called or not. This function is called for any Rx event.
      boolean CanHardwareLoopCheck: set at pre-compile, origin=Vector Informatik, default-value=true  # This parameter enables hardware loop check(s) to avoid endless loops. Under some conditions, the CAN driver has to wait for hardware dependent events. This will be done in a so-called 'Hardware Loop'. Refer to the technical reference documentation for usage of this kind of loops. To secure that this loop will not run infinitely, a timeout (CanTimeoutDuration) can be configured. A DET notification appears in this case. RESTRICTIONS: CanHardwareLoopCheck is only available, if hardware supports/needs this.
      boolean CanSecureTempBuffer: set at pre-compile, origin=Vector Informatik, default-value=false  # This parameter defines the usage of Secure Temp Buffers for hw-mailbox objects. RESTRICTIONS: 'CanSecureTempBuffer' is only available, if hardware supports a secure memory section for rx data buffering.
      string CanUserConfigFile [0..1]: set at pre-compile, origin=Vector Informatik, default-value=UserCfg  # Reference to an external text file that will be included during generation to Can_Cfg.h. The content of the user configuration file will be added at the end of the generated module configuration file and allows altering or extending the generated code. Caution: User configuration files can cause the software module to malfunction and must only be used with great care!
      boolean CanRxFullCANSupport: set at pre-compile, origin=Vector Informatik, default-value=true  # This parameter defines whether Rx FullCAN mailboxes shall be used or not. Deactivate it to save ROM and runtime consumption.
      boolean CanTxFullCANSupport: set at pre-compile, origin=Vector Informatik, default-value=true  # This parameter defines whether Tx FullCAN mailboxes shall be used or not. Deactivate it to save ROM and runtime consumption.
      boolean CanRxBasicCANSupport: set at pre-compile, origin=Vector Informatik, default-value=true  # This parameter defines whether Rx BasicCAN mailboxes shall be used or not. Deactivate it to save ROM and runtime consumption.
      boolean CanUseNestedCANInterrupts: set at pre-compile, origin=Vector Informatik, default-value=false  # This parameter defines whether CAN ISRs from different controllers can interrupt each other (only with higher priority). Deactivate this parameter to reduce runtime consumption. RESTRICTIONS: 'CanUseNestedCANInterrupts' is only available, if hardware supports this by mean of higher prior interrupts can be configured to interrupt CAN interrupts.
      boolean CanHardwareCancelByAppl: set at pre-compile, origin=Vector Informatik, default-value=false  # This parameter defines whether the application can cancel a hardware loop check. 'CanTimeoutDuration' will then be ignored ApplCanTimerStart() ApplCanTimerLoop() ApplCanTimerEnd() Callbacks have to be implemented in application. RESTRICTIONS: 'CanHardwareCancelByAppl' is only available, if 'CanHardwareLoopCheck' is enabled.
      boolean CanIndividualProcessing: set at pre-compile, origin=Vector Informatik, default-value=false  # Activate this when you like to configure each Rx and Tx mailbox object separate (deactivate to reduce runtime and memory consumption). RESTRICTIONS: 'CanIndividualProcessing' influences the settings of 'CanRxProcessing' and 'CanTxProcessing'. It is only available, if hardware supports/needs this and Highend licence is given.
      boolean CanGenericConfirmation: set at pre-compile, origin=Vector Informatik, default-value=false  # This parameter defines whether the Generic Confirmation function shall be called or not. (see also CanGenericConfirmationAPI2) The generic confirmation function is called for all Tx events.
      boolean CanGenericConfirmationAPI2: set at pre-compile, origin=Vector Informatik, default-value=false  # This parameter change the signature of the 'CanGenericConfirmation' in order to support bus mirroring. (Second use case is the support of CDD Mirror component for bus mirroring. See also 'CanMirrorModeSupport'.)
      boolean CanRxQueue: set at pre-compile, origin=Vector Informatik, default-value=false  # This parameter defines whether the Rx Queue shall be active or not. All Rx events will be queued in interrupt (id, dlc and data) and processed when calling Can_MainFunction_Read(). RESTRICTIONS: 'CanRxQueue' is only available, if hardware supports/needs this and Highend licence is given.
      boolean CanSupportMixedID: set at pre-compile, origin=Vector Informatik, default-value=false  # This parameter defines to force the code to contain mixed ID handling to be free afterwards using standard, extended or mixed IDs. No more ID type optimization! RESTRICTIONS: 'CanSupportMixedID' is only available, if hardware supports mixed ID handling. And it is not modify-able when mixed ID used in database.
      integer CanRxQueueSize: 2..65535, set at pre-compile, origin=Vector Informatik, default-value=10  # This value specifies the size of the Rx Queue in messages. If no Can_Mainfunction_Read() is called there will be overruns after receive this amount of messages. RESTRICTIONS: 'CanRxQueueSize' is only available, if 'CanRxQueue' is enabled.
      boolean CanMultipleBasicCANObjects: set at pre-compile, origin=Vector Informatik, default-value=false  # Activated when you use multiple BasicCAN hardware messages to optimize reception. (this allowes to use more hardware message filters, and hardware message buffers). RESTRICTIONS: 'CanMultipleBasicCANObjects' is only available, if hardware supports/needs this and Highend licence is given.
      boolean CanMultipleBasicCANTxObjects: set at pre-compile, origin=Vector Informatik, default-value=false  # Activated when you use multiple TX BasicCAN hardware messages to optimize transmission. (this allowes to use more hardware message buffers). RESTRICTIONS: 'CanMultipleBasicCANTxObjects' is only available, if hardware supports/needs this and Highend licence is given.
      enumeration CanHardwareHandleType: {UINT8, UINT16}, set at pre-compile, origin=Vector Informatik, default-value=UINT8  # Depend on the Platform, there is the need to use more than 8bit 'hardware mailbox handles' (defined by AutoSar 3.x). So it is possible to use 8bit or 16bit types (defined by AutoSar 4.x). RESTRICTIONS: 'CanHardwareHandleType' need to be set to 8bit when CanInterface without this support is used (Vector Interface >= 4.12 support 16bit).
      boolean CanOptimizeOneController: set at pre-compile, origin=Vector Informatik, default-value=false  # This parameter defines whether the code shall be optimized for one controller. RESTRICTIONS: 'CanOptimizeOneController' does only work when one controller is used,
      enumeration CanInterruptCategory: {CATEGORY2, CATEGORY1, VOIDFUNCVOID}, set at pre-compile, origin=Vector Informatik, default-value=VOIDFUNCVOID  # Specifies the type of Interrupt Function. Category 1: Interrupt Function has to be added to the interrupt vector table. Category 2: Interrupt Function is defined with ISR() define. void Func(void): Interrupt Function is defined as void Func(void) function. RESTRICTIONS: 'Category 2' is only relevant when AutoSar or OSEK OS is used otherwise the Interrupt will be Category 1.
      boolean CanGetStatus: set at pre-compile, origin=Vector Informatik, default-value=false  # This parameter defines whether the Can_GetStatus() API is available or not. The API returns the hardware states: CAN_STATUS_STOP, CAN_STATUS_INIT, CAN_STATUS_INCONSISTENT, CAN_STATUS_WARNING, CAN_STATUS_PASSIVE, CAN_STATUS_BUSOFF, CAN_STATUS_SLEEP
      enumeration CanInterruptLock: {DRIVER, APPL, BOTH}, set at pre-compile, origin=Vector Informatik, default-value=DRIVER  # This parameter defines who handles the interrupt locking. Disable and Restore Can Interrupt by CAN Driver or Application or CAN Driver and Application. Reason may be, that the CAN driver should not access the Interrupt controller for CAN interrupts or there are other restrictions (special security level) or Application has to care about additional Interrupts like Wakeup.
      boolean CanWakeupSupport: set at pre-compile, origin=Vector Informatik, default-value=false  # This parameter defines whether the CAN driver supports wakeup over CAN Bus (global switch for optimization). This switch will be set automatically for precompile configurations depending on the 'CanWakeupSupport' settings of the 'CanController'. RESTRICTIONS: 'CanWakeupSupport' is only available when Hardware supports Wakeup over Bus.
      enumeration CanRamCheck: {None, Active, MailboxNotification, Extended}, set at pre-compile, origin=Vector Informatik, default-value=None  # This parameter defines whether the RAM check for Rx and Tx mailboxes is active or not. The application notification functions "ApplCanCorruptMailbox" and "ApplCanMemCheckFailed" are called in case of RAM is corrupted. Controller will be deactivated and no communication will be processed. - None: Feature deactive - Active: "ApplCanMemCheckFailed" will be called in case of issue in any mailbox ID,DLC or data register. - Mailbox Notification: "ApplCanMemCheckFailed" and "ApplCanCorruptMailbox" will be called for dedicated mailbox ID,DLC or data register. - Extended: All relevant mailbox and controller register will be checked. Controller and mailbox failure will be notified and and objects deactivated. There is a possibility to activate mailboxes and controllers again.
      enumeration CanOverrunNotification: {None, DET, Application}, set at pre-compile, origin=Vector Informatik, default-value=DET  # This parameter defines whether the Rx Overrun Notification is active or not. None: Nothing is done. DET: DET is called. Application: Appl_CanOverrun is called.
      boolean CanReinitStart: set at pre-compile, origin=Vector Informatik, default-value=false  # ReInitialization While Start Transition | This parameter defines whether to process a full controller reinitialization at start transition (include hardware Rx and Tx mailboxes and control registers) or not. This cause significant runtime.
      boolean CanGenericPreTransmit: set at pre-compile, origin=Vector Informatik, default-value=false  # This parameter defines whether a generic pretransmit common for all Tx messages will be called when this checkbox is enabled. Use this to change data or abort transmission right before the message will be send.
      enumeration CanFdSupport: {NONE, BRS, FULL}, set at pre-compile, origin=Vector Informatik, default-value=NONE  # Specifies the kind of CAN FD support. NONE: CAN FD is deactivated BRS: Bitrate switching is activated but DLC is 8 byte at maximum FULL: Bitrate switching is activated and DLC can be 64 byte at maximum
      boolean CanRuntimeMeasurementSupport: set at pre-compile, origin=Vector Informatik, default-value=false  # If enabled runtime measurement points are added to the BSW module code and are added to the module configuration of MICROSAR RTM. The available measurement points can be seen and configured in the RTM module configuration. Availability of the MICROSAR RTM module is a prerequisite to make use of the runtime measurement functionality. Runtime measurement should be disabled in production code as measurement points may inflict additional runtime.
      integer CanMaxRxDataLen: 0..64, set at link in variant link-time / post-build in variant post-build-loadable+post-build-selectable / pre-compile in variant pre-compile, origin=Vector Informatik, default-value=8  # specifies the maximum amount of used bytes for receive buffers in case of CAN FD is activated.
      integer CanMaxTxDataLen: 0..64, set at link in variant link-time / post-build in variant post-build-loadable+post-build-selectable / pre-compile in variant pre-compile, origin=Vector Informatik, default-value=8  # specifies the maximum amount of used bytes for transmit buffers in case of CAN FD is activated.
      boolean CanUsePeripheralAccessApi: set at pre-compile, origin=Vector Informatik, default-value=false  # Use Peripheral Access API for access to those peripheral registers which need supervisor permissions. This allows the CAN driver to run in an untrusted OS Application.
      enumeration CanUseCore [0..1]: set at pre-compile, origin=Vector Informatik, default-value=Core_0  # CPU Core serving CAN Interrupt | Please Note: Only relevant for affected platforms (e.g. Tricore). Here you can set which CPU Core gets the CAN interrupt requests.
        Core_{0..5}  # CPU Core {0..5}
      boolean CanMirrorModeSupport: set at pre-compile, origin=Vector Informatik, default-value=false  # Use CDD Mirror component to route messages to other controllers. See specification of CDD Mirror component. (Require GenericPrecopy and GenericConfirmationAPI2)
      boolean CanUseOsInterruptControl: set at pre-compile, origin=Vector Informatik, default-value=false  # This parameter specifies whether the interrupt registers are acessed directly or over the OS. TRUE: Interrupt sources are controlled by the OS. Can uses API osDisableInterruptSource, osEnableInterruptSource and osClearPendingInterrupt to access the interrupt control registers. FALSE: Interrupt sources are controlled directly by this module.
      boolean CanSafeBswChecks: set at pre-compile, origin=Vector Informatik, default-value=false  # Selects if safety checks are used. These checks improve robustness as e.g. invalid parameters are checked before function is executed. This attribute has to be enabled for safety projects where this component is mapped to an ASIL partition.
      boolean CanSilentModeSupport: set at pre-compile, origin=Vector Informatik, default-value=false  # This parameter defines whether the CAN driver supports silent mode for CAN Bus (global switch for optimization).
      boolean CanHwTxFifoSupport: set at pre-compile, origin=Vector Informatik, default-value=false  # Hardware transmit FIFO support | This parameter defines whether the CAN driver supports hardware TX FIFOs for any CanHardwareObject (TxBasicCAN). (global switch for optimization).
      enumeration CanMcanRevision: {M_CAN_REV_30, M_CAN_REV_310, M_CAN_REV_315}, set at pre-compile, origin=Vector Informatik, default-value=M_CAN_REV_315  # Specifies your specific underlying M_CAN Core Step and Sub-Step Release. MCAN_REV_30 : MCAN Release 3.0.x, CAN-FD support with higher bitrates and extended data length MCAN_REV_310: MCAN Release 3.1.0, non-compatibility change to previous revisions MCAN_REV_315: MCAN Release 3.1.5, CAN-FD support with ISO-11898-1 compatibility The MCAN Revisions 3.2.x are compatible with MCAN_REV_315 and thus not mentioned separately.
      enumeration CanFdNISO [0..1]: {ISO_11898, Bosch_V10}, set at pre-compile, origin=Vector Informatik, default-value=ISO_11898  # Specifies the CAN-FD frame format conformance (ISO11898-1, Bosch CAN FD Spec. V1.0).
      integer CanMessageRAM [0..1]: 0..4294967295, set at link in variant link-time / post-build in variant post-build-loadable+post-build-selectable / pre-compile in variant pre-compile, origin=Vector Informatik, default-value=541065216  # Specifies the StartAddress for CAN Message RAM. NOTE: The configuration determines the actual RAM amount which is allocated.
      enumeration CanDataQualityOfService [0..1]: {DISABLE, LOW, MEDIUM, HIGH}, set at pre-compile, origin=Vector Informatik, default-value=LOW  # Specifies the memory priority access during the Message RAM read/write data operation. NOTE This is only used in ATSAME5X derivatives. DISABLE: Background (no sensitive operation) LOW: Sensitive bandwith MEDIUM: Sensitive latency HIGH: Critical latency
      boolean CanCheckWakeupCanRetType: set at pre-compile, origin=Vector Informatik, default-value=true  # This parameter defines whether the CAN driver supports the Can_ReturnType (true) or the Std_ReturnType (false) as return type for the Can_CheckWakeup() API. The value can be used to force the usage of Std_ReturnType to be compatibel to older CanInterfaces.
      boolean CanFdHardwareBufferOptimization: set at pre-compile, origin=Vector Informatik, default-value=true  # Enable optimizations for hardware buffer lengths | If selected the hardware buffers for FullCAN objects are limited to the framelength of the actual message to be received. In general this saves hardware resources but if CAN-FD messages with larger framelengths are received, they might be discarded by the driver. If this feature is disabled, the hardware buffers are configured to have maximum size to be able to receive all messages. See the hardware specific Technical Reference for details on the hardware buffer configuration.
      boolean CanEccInit: set at pre-compile, origin=Vector Informatik, default-value=true  # Specifies if the Can driver should perform initialization of the Can Message RAM. In case the Message RAM is equiped with parity or ECC functionality, it is recommended to initialize the Message RAM after hardware reset. An application callout will be given if this feature is disabled.
      boolean CanUseVirtualAddressing: set at pre-compile, origin=Vector Informatik, default-value=false  # This parameter specifies whether a virtual address space should be accessed instead of the CAN controller in hardware. TRUE: Virtual address space used FALSE: Virtual address space not used (default)
      boolean CanEnableSecurityEventReporting: set at pre-compile, origin=Vector Informatik, default-value=false  # Switches the reporting of security eventto the IdsM: - true: reporting is enabled. - false: reporting is disabled.
      reference CanCounterRef: set at pre-compile, destination=OsCounter  # This parameter contains a reference to a OS-counter, which is used by the CAN driver, to handle timeouts while mode transition and Hardware Loop timeouts.
      reference CanSupportTTCANRef [0..0]: set at pre-compile, destination=CanIfPrivateCfg  # Not Used. Not Supported. The parameter refers to CanIfSupportTTCAN parameter in the CAN Interface Module configuration. | The CanIfSupportTTCAN parameter defines whether TTCAN is supported.
      container CanMainFunctionRWPeriods  # This container contains the read and write periods (referred by CanHardwareObject).
        float CanMainFunctionReadPeriod [0..*]: 0.001..65.535, set at pre-compile, default-value=0.01  # This value specifies the period for cyclic call to Can_MainFunction_Read. EcuC unit is seconds. Different poll-cycles will be configurable if more than one CanMainFunctionReadPeriod is configured. In this case multiple Can_MainFunction_Read() will be provided by the CAN Driver module.
        float CanMainFunctionWritePeriod [0..*]: 0.001..65.535, set at pre-compile, default-value=0.01  # This value specifies the period for cyclic call to Can_MainFunction_Write. EcuC unit is seconds. Different poll-cycles will be configurable if more than one CanMainFunctionWritePeriod is configured. In this case multiple Can_MainFunction_Write() will be provided by the CAN Driver module.
  module config Can_Pre: definition=Can
  module config Can_Rec: definition=Can
