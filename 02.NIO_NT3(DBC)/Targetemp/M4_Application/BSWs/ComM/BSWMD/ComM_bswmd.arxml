AUTOSAR XML (schema 4-0-3)
# COPYRIGHT
# Copyright (c) 2022  by Vector Informatik GmbH. All rights reserved.
# This software is copyright protected and proprietary to Vector Informatik GmbH.
# Vector Informatik GmbH grants to you only those rights as set out in the license conditions.
package /MICROSAR
  module definition ComM [0..1]: category=VENDOR_SPECIFIC_MODULE_DEFINITION, refined-module-def=ComM, variants post-build-loadable/post-build-selectable/pre-compile  # Communication Manager (ComM). The ComM is a resource manager, which encapsulates the control of the underlying services. The main purpose is controlling of multiple communication requests by the application and wake-up events independent of the used bus system. #ModeManagement #NetworkManagement #Communication #Application #UserRequest #AUTOSAR #ServiceComponent
    container ComMConfigSet  # This container is the base for a multiple configuration set.
      boolean ComMPncEnabled [0..1]: set at post-build in variant post-build-loadable+post-build-selectable / pre-compile in variant pre-compile, default-value=false  # This parameter defines whether in this configuration set the Partial Networking is enabled. Dependency: this parameter is not used if Implementation Variant of ComM module is PreCompile or if parameter 'Pnc Support' is de-activated.
      container ComMChannel [1..*]  # This container includes the configuration parameters of a ComM channel. The parameters shall be harmonized within the whole communication stack. The 'Short Name' is used to compose a channel handle (#define) which is published in ComM_Lcfg.h during generation and has the format ComMConf_ComMChannel_<Short Name>.
        enumeration ComMBusType: {COMM_BUS_TYPE_CAN, COMM_BUS_TYPE_ETH, COMM_BUS_TYPE_FR, COMM_BUS_TYPE_INTERNAL, COMM_BUS_TYPE_LIN}, set at pre-compile, default-value=COMM_BUS_TYPE_CAN  # This parameter defines the bus type of the channel. Note: COMM_BUS_TYPE_INTERNAL shall be configured if the channel is used for internal communication. Such channels have no corresponding bus interface.
        integer ComMChannelId: 0..255, set at pre-compile, symbolic-name-value=true, default-value=255  # This value specifies the channel identification number of the corresponding channel. Identification numbers must be unique and consecutive.
        boolean ComMFullCommRequestNotificationEnabled: set at pre-compile, default-value=false  # This parameter defines if the optional SenderReceiver Port of Interface ComM_CurrentChannelRequest will be provided for this channel. Dependency: The value must be false if 'Nm Variant' of the channel is PASSIVE (in this case the channel cannot be requested by users).
        boolean ComMGlobalNvmBlockDescriptor [0..1]: set at pre-compile, default-value=false  # Not used! ComM always stores the wake-up inhibition state of the channel in the block pointed to by ComMGlobalNvmBlockDescriptor. This parameter defines if the wake-up inhibition state of the channel shall be stored (in some implementation specific way) in the block pointed to by ComMGlobalNvmBlockDescriptor.
        float ComMMainFunctionPeriod: 0.001..0.1, set at pre-compile, default-value=0.02  # This value specifies the period that the MainFunction has to be triggered with. Comment: ComM scheduling shall be at least as fast as the communication stack.
        boolean ComMNoCom: set at pre-compile in variant post-build-loadable+pre-compile / post-build in variant post-build-selectable, default-value=false  # This parameter defines if the mode limitation for this channel is enabled. The value is set at initialization time and can be changed during runtime with ComM_LimitChannelToNoComMode() or ComM_LimitECUToNoComMode(). Note that the value of runtime variable is not stored in NVRAM (not kept during a reset). Dependency: If enabled, the parameter ComMModeLimitationEnabled shall be enabled as well.
        boolean ComMNoWakeup: set at pre-compile in variant post-build-loadable+pre-compile / post-build in variant post-build-selectable, default-value=false  # This parameter defines if the wake-up inhibition for this channel is enabled. The parameter defines the default value, which is set only once at first ECU initialization or if the non-volatile data cannot be restored. The value can be changed during runtime with ComM_PreventWakeUp(). The current value can be stored in NVRAM (kept during a reset) if ComMGlobalNvMBlockDescriptor is configured. Dependency: If enabled, the parameter ComMWakeupInhibitionEnabled shall be enabled as well.
        enumeration ComMPncGatewayType [0..1]: {COMM_GATEWAY_TYPE_ACTIVE, COMM_GATEWAY_TYPE_PASSIVE, COMM_GATEWAY_TYPE_NONE}, set at pre-compile, default-value=COMM_GATEWAY_TYPE_NONE  # This parameter defines the Partial Network Gateway behavior of this channel. Note: ComM does only allow coordinated ComMPncs with either all referenced ComMChannels having the ComMPncGatewayType set to COMM_GATEWAY_TYPE_NONE or no referenced ComMChannel has COMM_GATEWAY_TYPE_NONE set.
        reference ComMManageReference [0..1]: set at pre-compile, origin=Vector Informatik, destination=ComMChannel  # This parameter represents the relation between a managing and a managed ComMChannel. The ComMChannel having this parameter set is the managed channel. The managed channel references the corresponding managing channel within this parameter. A managing channel can be referenced by 1..n managed channels. Note: The ComMNmVariant for managed channels has to be set to LIGHT and for managing channels it has to be set to FULL.
        reference ComMChannelPartitionRef [0..1]: set at pre-compile, origin=Vector Informatik, destination=EcucPartition  # Reference to EcucPartition, where the according ComMChannel is assigned to.
        container ComMNetworkManagement  # This container includes the ComM configuration parameters for Network Management.
          float ComMNmLightTimeout [0..1]: 0..255, set at pre-compile in variant post-build-loadable+pre-compile / post-build in variant post-build-selectable, default-value=10  # This parameter is only available if Nm Variant is LIGHT. This value specifies the time duration spent in the COMM_FULL_COMMUNICATION sub-state COMM_FULL_COM_READY_SLEEP before ComM triggers the network shutdown. If the value is 0.0, ComM omits the state COMM_FULL_COM_READY_SLEEP. Dependency: the next state depends on the optional parameter ComMNmLightSilentTimeout.
          enumeration ComMNmVariant: {FULL, LIGHT, NONE, PASSIVE, LINSLAVE}, set at pre-compile in variant post-build-loadable+pre-compile / post-build in variant post-build-selectable, default-value=FULL  # This parameter defines which Network Management variant is supported on the channel: - FULL, AUTOSAR NM is used. - PASSIVE, AUTOSAR NM is used, but the ECU is not allowed to keep the network awake. It is not allowed to assign users to this channel. ComM ignores communication requests from DCM on this channel. The parameter ComMNoCom of the channel has to be set to true. - LIGHT, no AUTOSAR NM is used, but the shutdown is synchronized via timeout, which is configured with the parameter ComMNmLightTimeout. - NONE, no AUTOSAR NM is used and no shutdown synchronization is available. I.e. once a channel reached the COMM_FULL_COMMUNICATION mode, it will never leave it. Stop of communication is done via power off or reset. ComM ignores user requests of COMM_NO_COMMUNICATION mode and requests for No Communication Mode Limitation. - LINSLAVE, no AUTOSAR NM is used but LIN slave use case. Shutdown is synchronized by LIN master. Cannot keep the bus awake but LIN State Manager restarts wakeup repetition. Note: The parameter shall be harmonized with the configuration of Network Management modules (if any). Dependencies: For channels with Bus Type INTERNAL only the Nm Variant LIGHT is supported. For managing channels (see ComMManageReference), the ComMNmVariant FULL shall be configured. For managed channels (see ComMManageReference), the ComMNmVariant LIGHT shall be configured.
          boolean ComMPncNmRequest: set at pre-compile in variant post-build-loadable+pre-compile / post-build in variant post-build-selectable, default-value=false  # This parameter defines if every time a Full Communication is requested due to a change in the PNC state machine to COMM_PNC_REQUESTED Nm shall be called using the API Nm_NetworkRequest(), even if the channel is already in Full Communication. Dependency: this parameter is considered only if 'Pnc Support' is activated.
          float ComMNmLightSilentTimeout [0..1]: 0..255, set at pre-compile in variant post-build-loadable+pre-compile / post-build in variant post-build-selectable, origin=Vector Informatik, default-value=1.5  # This value specifies the time duration spent in the COMM_SILENT_COMMUNICATION state after leaving COMM_FULL_COM_READY_SLEEP state and before entering COMM_NO_COMMUNICATION state. The COMM_SILENT_COMMUNICATION state can be left in three ways: - The ComMNmLightSilentTimeout elapses: COMM_NO_COMMUNICATION is entered - On internal Full Comm request: COMM_FULL_COMMUNICATION is entered - On Dcm Diagnostics Active indication: COMM_FULL_COMMUNICATION is entered This is similar to the Prepare Bus Sleep Phase when Network Management is used. If the value is 0.0 or this parameter is missing, ComM omits the state COMM_SILENT_COMMUNICATION and enters COMM_NO_COMMUNICATION directly. Restrictions: This parameter is only available for Bus Type CAN with Nm Variant LIGHT.
          float ComMTMinFullComModeDurationOfChannel [0..1]: 0.001..65, set at pre-compile in variant post-build-loadable+pre-compile / post-build in variant post-build-selectable, origin=Vector Informatik, default-value=5  # This value specifies the minimum time duration, spent in the COMM_FULL_COMMUNICATION sub-state COMM_FULL_COM_NETWORK_REQUESTED. The parameter is only available for channels with Nm Variants FULL and LIGHT. - If the channel has Nm Variant LIGHT, this parameter is used instead of the global TMin Full Com Mode Duration. - If the channel has Nm Variant FULL, it is recommended -- to use this parameter if the corresponding BusNm does not support the Repeat Message Time functionality (e.g. NmOsek). -- not to use this parameter if the corresponding BusNm supports the Repeat Message Time functionality (e.g. CanNm, FrNm or UdpNm).
        container ComMUserPerChannel [0..*]  # This container includes a reference to a ComMUser that is assigned to this channel.
          reference ComMUserChannel: set at pre-compile, destination=ComMUser  # Reference to a ComMUser that is assigned to this channel.
      container ComMPnc [0..*]  # This container includes the configuration of a Partial Network Cluster (PNC). The 'Short Name' is used to compose a PNC handle (#define) which is published in ComM_Lcfg.h during generation and has the format ComMConf_ComMPnc_<Short Name>.
        integer ComMPncId: 0..511, set at pre-compile, origin=Vector Informatik, symbolic-name-value=true  # This value specifies the partial network cluster (PNC) identification number. The number defines the bit position of the PNC status information in bit vectors EIRA and ERA. The concrete meaning depends on the value of the parameter ComMPncIdCounting. The example shows which PNC ID corresponds to the bit position 0 (LSB) in the bit vectors: - if ComMPncIdCounting = COMM_PNC_ID_COUNT_FROM_PNC_VECTOR, status information of PNC with ComMPncId = 0 is stored. - if ComMPncIdCounting = COMM_PNC_ID_COUNT_FROM_NM_MESSAGE, status information of PNC with ComMPncId = (Pnc Vector Offset * 8) is stored.
        reference ComMChannelPerPnc [0..*]: set at post-build in variant post-build-loadable+post-build-selectable / pre-compile in variant pre-compile, destination=ComMChannel  # Reference to a ComMChannel that is required for this PNC.
        reference ComMUserPerPnc [0..*]: set at post-build in variant post-build-loadable+post-build-selectable / pre-compile in variant pre-compile, destination=ComMUser  # Reference to a ComMUser that is assigned to this PNC.
        reference ComMPortGroupsPerPnc [0..255]: set at post-build in variant post-build-loadable+post-build-selectable / pre-compile in variant pre-compile, origin=Vector Informatik, destination=EthIfSwitchPortGroup  # Reference to the PortGroups that correspond to this PNC. Dependencies: - At least one EthIfSwitchPortGroup shall be assigned to a PNC, if it is referenced by EcuMWakeupSource/EcuMComMPNCRef - ComM channels that are referenced by a PNC are not allowed to be referenced by any ComMUsers, if the PNC references at least one EthIfSwitchPortGroup.
        container ComMPncComSignal [0..*]  # This container includes PncComSignals which are used to communicate the EIRA and ERA status of this PNC. The following rules shall be considered: - ERA is only needed if ComMPncGatewayEnabled is set to true and only for PNCs, which are assigned to multiple ComM channels. In this case a separate PncComSignal with ComMPncComSignalKind = ERA and ComMPncComSignalDirection = RX shall be configured for each channel assigned to the PNC. - A separate PncComSignal with ComMPncComSignalKind = EIRA and ComMPncComSignalDirection = TX shall be configured for each channel that is assigned to the PNC and has ComMNmVariant = FULL. - A separate PncComSignal with ComMPncComSignalKind = EIRA and ComMPncComSignalDirection = RX shall be configured for each bus type (e.g. one for CAN and one for FR if both CAN and FR channels are assigned to the PNC).
          enumeration ComMPncComSignalDirection: {RX, TX}, set at pre-compile  # This parameter defines the communication direction of this PncComSignal.
          enumeration ComMPncComSignalKind: {EIRA, ERA}, set at pre-compile  # This parameter defines whether this PncComSignal represents EIRA or ERA PNC information.
          boolean ComMUseSignalIndependentlyOfChannelAssignment [0..1]: set at post-build in variant post-build-loadable+post-build-selectable / pre-compile in variant pre-compile, origin=Vector Informatik, default-value=false  # This parameter is only relevant: - if ComMPncExtendedFunctionalityEnabled is set to true and - the ComMPncComSignal is an ERA RX signals or an EIRA TX signal and - the ComMPncComSignal is configured for a ComMChannel which is not referenced by the ComMPnc. If all of the above conditions are true, this parameter has the following meaning: - If it is set to true, the signal will be used by the PNC (even if the ComMPnc has no ComMChannelPerPnc reference to the corresponding channel) -- For EIRA TX signals, this means that the corresponding PNC bit will be set in the signal data -- For ERA RX signals, this means that reception of a corresponding PNC bit will lead to activation of the PNC. - If it is set to false, the signal will NOT be used by the PNC -- For EIRA TX signals, this means that the corresponding PNC bit will not be set in the signal data -- For ERA RX signals, this means that reception of a corresponding PNC bit will not lead to activation of the PNC. Note: EIRA RX signals are always evaluated by ComM. If EIRA RX signals shall not be considered for some PNCs, a corresponding filter mask shall be defined in the BusNm.
          reference ComMPncComSignalChannelRef [0..1]: set at pre-compile, destination=ComMChannel  # Reference to the ComMChannel which is assigned to the PNC. The parameter is not applicable for signals with ComMPncComSignalKind = EIRA and ComMPncComSignalDirection = RX. In this case the PncComSignal refers to a bus type (e.g. CAN) rather than to a channel. Dependency: If ComMPncComSignalKind = ERA and ComMPncComSignalDirection = RX, the parameter is used to determine whether this PncComSignal shall participate in the active or passive role (via the parameter ComMPncGatewayType of the ComMChannel).
          symbolic name reference ComMPncComSignalRef: set at pre-compile, destination=ComSignal  # Reference to the ComSignal which is used to transport the partial network channel request information. Dependency: For each ComPncSignal with ComMPncComSignalDirection = RX the parameter ComNotification of the COM module shall be set to a unique value. The parameter specifies the name of a callback function which is defined in ComM_Lcfg.c during generation. The parameter should include the 'Name' of the corresponding ComSignal according to the pattern ComM_ComCbk_<Name>.
      container ComMUser [1..*]  # This container includes the information of a ComM User which is designated to request Communication modes. The 'Short Name' is used to compose a user handle (#define) which is published in ComM_Lcfg.h during generation and has the format ComMConf_ComMUser_<Short Name>.
        integer ComMUserIdentifier: 0..65535, set at pre-compile, origin=Vector Informatik, symbolic-name-value=true  # This value specifies the identifier that is needed to refer to a user in the system which is designated to request Communication Modes.
        boolean ComMUserModeNotification: set at pre-compile, origin=Vector Informatik, default-value=false  # This parameter defines if the mode notification to this user is enabled.
        reference ComMUserEcucPartitionRef [0..1]: set at pre-compile, destination=EcucPartition  # Denotes in which "EcucPartition" the requester is executed. When the partition is stopped, the communication request shall be cancelled in the ComM to avoid a stay-awake situation of the bus due to a stopped partition.
    container ComMGeneral  # General configuration parameters of the Communication Manager.
      boolean ComMDevErrorDetect: set at pre-compile, default-value=true  # This parameter switches the Development Error Detection and Notification ON or OFF. true: Development error detection is enabled. false: Development error detection is disabled. Note: In general, the development error detection is recommended during pre-test phase. It is not recommended to enable the development error detection in production code due to increased runtime and ROM needs.
      boolean ComMDirectUserMapping [0..0]: set at pre-compile, default-value=false  # Not used! This parameter defines if the configuration tool shall automatically create a ComMUser per ComMPnc and a ComMUser per ComMChannel. The 'Short Name' of the generated ComMUsers shall follow the following naming convention: PNCUser_ComMPncId, e.g. PNCUser_13 ChannelUser_ComMChannelId, e.g. ChannelUser_25 Restriction: ComMUser, which are created due to this configuration parameter, shall not be used by SWCs (only available for BswM).
      integer ComMEcuGroupClassification: 0..255, set at pre-compile, default-value=3  # This value specifies whether a mode inhibition affects the ECU or not. 0, not affected by mode inhibition 1, only affected by the bus wake-up inhibition 2, only affected by the mode limitation 3, affected by both mode inhibitions above. The parameter defines the default value, which is set only once at first ECU initialization or if non-volatile data cannot be restored. It can be changed during runtime with ComM_SetECUGroupClassification(). The current value can be stored in NVRAM (kept during a reset) if ComMGlobalNvMBlockDescriptor is configured. Note that the parameter does not control the availability of mode inhibition functionality. The functionality has to be enabled with parameters ComMModeLimitationEnabled and ComMWakeupInhibitionEnabled if needed.
      boolean ComMModeLimitationEnabled: set at pre-compile, default-value=false  # This parameter defines if Mode Limitation functionality shall be enabled. Dependencies: - If the value is true, the optional parameter ComMGlobalNvMBlockDescriptor can be configured. - The value shall be true if ComMNmVariant is PASSIVE.
      boolean ComMPncGatewayEnabled [0..1]: set at pre-compile, default-value=false  # This parameter defines if support of Partial Network Gateway is enabled.
      float ComMPncPrepareSleepTimer [0..1]: 0..63, set at pre-compile, default-value=5  # This value specifies the time the PNC state machine shall wait in COMM_PNC_PREPARE_SLEEP.
      boolean ComMPncSupport: set at pre-compile, default-value=false  # This parameter defines if support of Partial Networking is enabled.
      boolean ComMSynchronousWakeUp: set at pre-compile, default-value=true  # This parameter defines if a wake-up of one channel shall lead to a wake-up of all channels. Dependency: The value must be false if J1939 Network Management is used on a ComM channel and no AUTOSAR Network Management is used on this channel.
      float ComMTMinFullComModeDuration: 0.001..65, set at pre-compile, default-value=5  # This value specifies the minimum time duration, spent in the COMM_FULL_COMMUNICATION sub-state COMM_FULL_COM_NETWORK_REQUESTED. The parameter is only available for channels with ComMNmVariant = LIGHT.
      boolean ComMVersionInfoApi: set at pre-compile, default-value=false  # This parameter enables/disables the function ComM_GetVersionInfo() to get major, minor and patch version information.
      boolean ComMWakeupInhibitionEnabled: set at pre-compile, default-value=false  # This parameter defines if the wake-up inhibition functionality is enabled. Dependency: If the value is true, the optional parameter ComMGlobalNvMBlockDescriptor can be configured.
      string ComMUserConfigurationFile [0..1]: set at pre-compile, origin=Vector Informatik  # Reference to an external text file that will be included during generation to ComM_Cfg.h. The content of the user configuration file will be added at the end of the generated module configuration file ComM_Cfg.h and allows altering or extending the generated code. Caution: User configuration files can cause the software module to malfunction and must only be used with great care!
      boolean ComMNmPassiveModeEnable [0..1]: set at pre-compile, origin=Vector Informatik, default-value=false  # This parameter defines the possible values of the parameter ComMNmVariant: true: the values of ComMNmVariant are limited to LIGHT, NONE and PASSIVE. false: the values of ComMNmVariant are limited to LIGHT, NONE and FULL. If the parameter does not exist, all values of ComMNmVariant are potentially possible, as long as consistency with Network Management modules and consistency within ComM module itself is ensured.
      boolean ComMOperationGetInhibitionStatusEnabled [0..1]: set at pre-compile, origin=Vector Informatik, default-value=true  # This parameter defines whether the client-server interface ComM_ChannelWakeUp contains the operation GetInhibitionStatus. true: the interface ComM_ChannelWakeUp contains the operation GetInhibitionStatus. This is the default value. false: the interface ComM_ChannelWakeUp does not contain the operation GetInhibitionStatus. If the parameter does not exist, the behavior is as if the value were true.
      enumeration ComMPncIdCounting [0..1]: {COMM_PNC_ID_COUNT_FROM_PNC_VECTOR, COMM_PNC_ID_COUNT_FROM_NM_MESSAGE}, set at pre-compile, origin=Vector Informatik, default-value=COMM_PNC_ID_COUNT_FROM_PNC_VECTOR  # This parameter specifies the meaning of the ComMPncId parameters. - If this parameter is set to COMM_PNC_ID_COUNT_FROM_PNC_VECTOR, then PNC IDs are counted from the beginning of the PNC Vector. The range of valid PNC IDs then goes from 0 to (8 * (#bytes in Pnc Vector)) - 1. This corresponds to the PNC ID handling as specified in AUTOSAR Specifications Version 4.0.x. - If this parameter is set to COMM_PNC_ID_COUNT_FROM_NM_MESSAGE, then PNC IDs are counted from the beginning of the NM Message. The range of valid PNC IDs then goes from (8 * Pnc Vector Offset) to (8 * (Pnc Vector Offset + #bytes in Pnc Vector)) - 1. This corresponds to the PNC ID handling as specified in AUTOSAR Specifications since Version 4.1.x.
      boolean ComMPncExtendedFunctionalityEnabled [0..1]: set at pre-compile, origin=Vector Informatik, default-value=false  # This parameter specifies if Extended Partial Networking functionality is enabled. Please refer to the Startup User Manual for further information. Dependency: The value must be false if 'Pnc To Channel Routing Limitation Enabled' is true.
      boolean ComMPncToChannelRoutingLimitationEnabled [0..1]: set at pre-compile, origin=Vector Informatik, default-value=false  # Enables or disables support of Partial Network Routing Limitation feature. False: Partial Network Routing Limitation is disabled. This is the default setting. In this case ComM will route Partial Networking requests to all channels mapped to the Partial Network according to AUTOSAR specification. The API ComM_LimitPncToChannelRouting() is not available. True: Partial Network Routing Limitation is enabled. In this case it is possible to limit the routing of Partial Networking requests on particular channels mapped to the Partial Network. The API ComM_LimitPncToChannelRouting() is available. If a Partial Network is requested, the behavior depends on the current limitation status of a channel: - if not limited, ComM keeps the channel awake and Nm sends its message containing PN request information as defined by AUTOSAR. - if limited, ComM does not keep the channel awake and Nm does not send its message. Dependencies: - The value must be false if 'Pnc Extended Functionality Enabled' is true. - The feature can be enabled only if 'Pnc Gateway Enabled' is set to true. - The feature is only available for channels having 'Pnc Gateway Type' set to COMM_GATEWAY_TYPE_ACTIVE or COMM_GATEWAY_TYPE_PASSIVE. Refer to the Technical Reference for further information.
      boolean ComMExtendedRamCheck [0..1]: set at pre-compile, origin=Vector Informatik, default-value=false  # This parameter enables/disables extended RAM check of the CAN registers and Message Boxes. If enabled, ComM evaluates the status of extended RAM check before starting communication on a channel. Dependency: The value must be false if 'Pnc Support' is true.
      boolean ComMResetAfterForcingNoComm [0..1]: set at pre-compile, origin=Vector Informatik, default-value=false  # This parameter defines if ComM shall force an ECU reset by invoking BswM_ComM_InitiateReset() after a channel entered No Communication mode because of an active Mode Limitation. Dependencies: - if enabled, the parameter ComMModeLimitationEnabled must be enabled as well. - if enabled, at least one channel must have Nm Variant FULL or LIGHT (because Mode Limitation cannot be applied to channels with Nm Variant PASSIVE or NONE). - if enabled, you need to configure a BswM Mode Request Port with the Source BswMComMInitiateReset.
      boolean ComMSafeBswChecks: set at pre-compile, origin=Vector Informatik, default-value=false  # Selects if safety checks are used. These checks improve robustness as e.g. invalid parameters are checked before function is executed. This attribute has to be enabled for safety projects where this component is mapped to an ASIL partition.
      boolean ComM0PncVectorAvoidance [0..1]: set at pre-compile, origin=Vector Informatik, default-value=true  # This parameter defines, if ComM sends PNC-Vectors containing only '0' (no external or internal requests) on passive channels. If the parameter is set to TRUE and all signals for the referenced ComMChannel(s) are set to '0', ComM releases the corresponding ComMChannel. Thus, it is avoided to send the PNC-Vector containing only '0'. If the parameter is set to FALSE and all signals for the referenced ComMChannel(s) are set to '0', ComM does not release the corresponding ComMChannel. Thus, ComM continues sending the PNC-Vector containing only '0'. Note: This parameter can only be set to TRUE if ComMPncGatewayEnabled is enabled and a channel with gateway type passive exists. In this case, it is recommended to set this parameter to TRUE in order to avoid the passive channels to be kept awake unnecessarily and thus avoid sending PNC-Vectors containing only '0'.
      boolean ComMSynchronizedPncShutdownEnabled [0..1]: set at pre-compile, origin=Vector Informatik, default-value=false  # Enables or disables the support of synchronized PNC shutdown. false: synchronized PNC shutdown is disabled. This is the default setting. true: synchronized PNC shutdown is enabled. Dependency: - This feature can only be enabled for ECUs in the role of a Top-Level-PNC-Coordinator (TLPC) or an intermediate PNC coordinator. It cannot be enabled for subordinated (or leaf) nodes. - The feature can be enabled only if 'Pnc Gateway Enabled' is true. - The feature cannot be enabled if 'Pnc Extended Functionality Enabled' is true.
      symbolic name reference ComMGlobalNvMBlockDescriptor [0..1]: set at pre-compile, destination=NvMBlockDescriptor  # Global NvM Block Descriptor | Reference to NVRAM block containing the non-volatile data where the status information of Mode Limitation and Wake-up Inhibition is persisted. The parameter is optional, it can be configured if ComMWakeupInhibitionEnabled or ComMModeLimitationEnabled is set to true in order to persist the status information. Dependency: if ComMGlobalNvMBlockDescriptor is configured, the parameter NvMRamBlockDataAddress has to be set to ComM_Inhibition. If no ComMGlobalNvMBlockDescriptor is configured, no NvM data will be stored by ComM. In this case, the status values of Mode Limitation and Wake-up Inhibition will be re-initialized on each ComM_Init call. The following values are affected: - the state of Wake-up Inhibition if changed at run-time via ComM_PreventWakeUp() and - the number of inhibited requests of FULL_COM by ComM users assigned to channels which have Mode Limitation or Wake-up Inhibition activated and - the ECU Group Classification if changed at run-time via ComM_SetECUGroupClassification().
      reference ComMEcucPartitionRef [0..1]: set at pre-compile, origin=Vector Informatik, destination=EcucPartition  # Reference to EcucPartition, where the ComM Master-Partition is assigned to.
      container ComMGeneration  # Contains the generation configuration parameters of the Communication Manager.
        boolean ComMOutOfBoundsWriteSanitizer: set at pre-compile, origin=Vector Informatik, default-value=false  # This parameter activates/deactivates the generation of runtime checks which call a DET error notification function to find easily out of bounds write problems. FALSE: no checks are generated in the data access. TRUE: the data access is enriched with DET checks to validate indexes.
        boolean ComMOutOfBoundsReadSanitizer: set at pre-compile, origin=Vector Informatik, default-value=false  # This parameter activates/deactivates the generation of runtime checks which call a DET error notification function to find easily out of bounds read problems. FALSE: no checks are generated in the data access. TRUE: the data access is enriched with DET checks to validate indexes.
  bsw implementation ComM_Impl: programming-language=C, sw-version=15.00.01, used-code-generator=DaVinci Configurator, vendor-id=30, ar-release-version=4.00.03, behavior=ComMBehavior, preconfigured-configuration=ComM_Pre, recommended-configuration=ComM_Rec, vendor-specific-module-def=ComM
  module config ComM_Pre: definition=ComM
  module config ComM_Rec: definition=ComM
